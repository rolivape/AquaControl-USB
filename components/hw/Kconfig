## components/hw/Kconfig
```kconfig
menu "Opciones de Hardware"

    choice
        prompt "Selecciona el tipo de Panel"
        default HW_PANEL_AC
    
    config HW_PANEL_AC
        bool "Panel AC"
    
    config HW_PANEL_DC
        bool "Panel DC"
    
    config HW_PANEL_IO
        bool "Panel IO"
    
    endchoice
    
    endmenu
```
